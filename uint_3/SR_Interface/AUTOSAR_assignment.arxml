AUTOSAR XML (schema 00046)
package /INTERFACES_LAB
  sender receiver interface SRI1
    data var1: sw-impl-policy=QUEUED, type=uint32, init-value=12
    data var2: sw-impl-policy=QUEUED, type=uint16, init-value=6
  application sw component type SWC1
    provide port Pport1: provided-interface=SRI1
  application sw component type SWC2
    require port Rport1: required-interface=SRI1

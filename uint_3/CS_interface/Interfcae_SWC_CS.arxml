AUTOSAR XML (schema 00046)
package /CS_IF_lidar
  client server interface CS_IF
    operation CS_IF_SUM
      arg IN1: type=uint16, direction=IN
      arg IN2: type=uint16, direction=IN
      arg OUT: type=uint32, direction=OUT
  application sw component type SWC_SERVER
    provide port Pport1_CS: client-server-annotation=CS_IF_SUM
  application sw component type SWC_client
    require port Rport1_CS: client-server-annotation=CS_IF_SUM
